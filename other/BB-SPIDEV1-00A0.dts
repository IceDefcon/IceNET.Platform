/dts-v1/;

/ {

	fragment@0 {
		target-path = [2f 00];

		__overlay__ {

			chosen {

				overlays {
					BB-SPIDEV1-00A0 = "Sat Aug 21 14:57:17 2021";
				};
			};
		};
	};

	fragment@1 {
		target = <0xffffffff>;

		__overlay__ {

			P9_28_pinmux {
				status = "disabled";
			};

			P9_30_pinmux {
				status = "disabled";
			};

			P9_29_pinmux {
				status = "disabled";
			};

			P9_31_pinmux {
				status = "disabled";
			};
		};
	};

	fragment@2 {
		target = <0xffffffff>;

		__overlay__ {

			pinmux_bb_spi1_pins {
				pinctrl-single,pins = <0x190 0x33 0x194 0x33 0x198 0x13 0x19c 0x13>;
				phandle = <0x01>;
			};
		};
	};

	fragment@3 {
		target = <0xffffffff>;

		__overlay__ {
			#address-cells = <0x01>;
			#size-cells = <0x00>;
			status = "okay";
			pinctrl-names = "default";
			pinctrl-0 = <0x01>;

			channel@0 {
				#address-cells = <0x01>;
				#size-cells = <0x00>;
				compatible = "spidev";
				symlink = "spi/1.0";
				reg = <0x00>;
				spi-max-frequency = <0xf42400>;
				spi-cpha;
			};

			channel@1 {
				#address-cells = <0x01>;
				#size-cells = <0x00>;
				compatible = "spidev";
				symlink = "spi/1.1";
				reg = <0x01>;
				spi-max-frequency = <0xf42400>;
			};
		};
	};

	__symbols__ {
		bb_spi1_pins = "/fragment@2/__overlay__/pinmux_bb_spi1_pins";
	};

	__fixups__ {
		ocp = "/fragment@1:target:0";
		am33xx_pinmux = "/fragment@2:target:0";
		spi1 = "/fragment@3:target:0";
	};

	__local_fixups__ {

		fragment@3 {

			__overlay__ {
				pinctrl-0 = <0x00>;
			};
		};
	};
};
